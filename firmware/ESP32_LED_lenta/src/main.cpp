// =============================================================
//  ЛЕНТА WS2812B + ДАТЧИК РАССТОЯНИЯ HC-SR04
// =============================================================
//  Что делает эта программа:
//   1. Датчик HC-SR04 измеряет расстояние до твоей руки/объекта.
//   2. Чем БЛИЖЕ объект  -> тем БОЛЬШЕ диодов на ленте горит.
//   3. Чем БЛИЖЕ объект  -> тем КРАСНЕЕ они (далеко = зелёные, близко = красные).
//
//  Все настройки (пины, кол-во диодов, диапазон) лежат в config.h.
// =============================================================
//
//  МИНИ-СЛОВАРИК (чтобы код не пугал):
//   • pulseIn      – ждёт, пока на пине появится сигнал, и возвращает его длительность (мкс).
//   • map()        – «переносит» число из одного диапазона в другой (например, см -> кол-во диодов).
//   • constrain()  – не даёт числу выйти за минимум и максимум.
//   • CHSV(...)    – задаёт цвет по схеме: Оттенок(H), Насыщенность(S), Яркость(V).
//                    Оттенок 0 = красный, 120 = зелёный.
//   • «сглаживание»– чтобы показания не дёргались, новое значение смешиваем со старым.
//
// =============================================================

#include <Arduino.h>   // база для ESP32/Arduino
#include <FastLED.h>    // библиотека для управления лентой
#include "config.h"     // твои настройки

// Память под все диоды ленты (массив цветов)
CRGB leds[NUM_LEDS];

// Переменные «состояния» — они меняются во время работы:
float distance = MAX_DIST;   // текущее расстояние (уже сглаженное)
float litCount = 0;          // сколько диодов горит (уже сглаженное)
float lastGood = MAX_DIST;   // последнее ДОСТОВЕРНОЕ расстояние


// -------------------------------------------------------------
//  ШАГ 1. Измеряем расстояние одним "пингом" датчика
// -------------------------------------------------------------
float readDistanceCM()
{
  // Делаем несколько замеров подряд, чтобы отфильтровать случайный шум.
  float samples[SAMPLES];

  for (int i = 0; i < SAMPLES; i++)
  {
    // 1) посылаем короткий ультразвуковой импульс (пины TRIG)
    digitalWrite(TRIG_PIN, LOW);
    delayMicroseconds(2);
    digitalWrite(TRIG_PIN, HIGH);
    delayMicroseconds(10);
    digitalWrite(TRIG_PIN, LOW);

    // 2) ловим эхо (пин ECHO): сколько микросекунд летел сигнал туда-обратно
    long travelTime = pulseIn(ECHO_PIN, HIGH, 30000); // 30000 мкс = таймаут

    // 3) если эхо не вернулось (duration == 0) — НЕ паникуем,
    //    оставляем старое значение, иначе лента резко погаснет.
    if (travelTime == 0 || travelTime > MAX_VALID_DIST * SOUND_SPEED_DIV * 2)
    {
      samples[i] = lastGood;
    }
    else
    {
      // переводим время полёта в сантиметры:
      // расстояние = время / скорость_звука_в_мкс_на_см / 2 (туда и обратно)
      samples[i] = travelTime / SOUND_SPEED_DIV / 2.0;
    }

    delay(SAMPLE_DELAY); // небольшая пауза, датчику нужно "передохнуть"
  }

  // Сортируем замеры по возрастанию и берём СРЕДНИЙ.
  // Это называется "медиана" — она убирает редкие выбросы (например, 5, 30, 6 -> берём 6).
  for (int i = 1; i < SAMPLES; i++)
  {
    float v = samples[i];
    int j = i - 1;
    while (j >= 0 && samples[j] > v)
    {
      samples[j + 1] = samples[j];
      j--;
    }
    samples[j + 1] = v;
  }

  lastGood = samples[SAMPLES / 2]; // запоминаем для следующего раза
  return lastGood;
}


// -------------------------------------------------------------
//  ШАГ 2. Плавно смешиваем старое и новое значение
// -------------------------------------------------------------
//  k = 1.0 -> мгновенно (дёргано);  k = 0.1 -> очень медленно.
//  Это называется "экспоненциальное сглаживание".
float smooth(float oldValue, float newValue, float k)
{
  return oldValue + k * (newValue - oldValue);
}


// -------------------------------------------------------------
//  ШАГ 3. Рисуем на ленте: зажигаем нужное число диодов
// -------------------------------------------------------------
void updateLeds(float howMany)
{
  int count = (int)(howMany + 0.5);     // округляем до целого
  count = constrain(count, 0, NUM_LEDS); // не больше, чем диодов в ленте

  for (int i = 0; i < NUM_LEDS; i++)
  {
    if (i < count)
    {
      // Вдоль зажжённой части делаем градиент:
      // первый диод — зелёный (120), последний — красный (0).
      uint8_t hue = map(i, 0, NUM_LEDS - 1, 120, 0);
      leds[i] = CHSV(hue, 255, 255);
    }
    else
    {
      leds[i] = CRGB::Black; // остальные не горят
    }
  }

  FastLED.show(); // отправляем картинку на ленту
}


// -------------------------------------------------------------
//  НАСТРОЙКА (выполняется один раз при включении)
// -------------------------------------------------------------
void setup()
{
  Serial.begin(115200); // включаем "порт" для отладки (вывод в монитор)

  pinMode(TRIG_PIN, OUTPUT); // TRIG посылает сигнал
  pinMode(ECHO_PIN, INPUT);  // ECHO принимает эхо

  FastLED.addLeds<WS2812B, LED_PIN, GRB>(leds, NUM_LEDS); // подключаем ленту
  FastLED.setBrightness(LED_BRIGHTNESS);                  // яркость
  FastLED.clear();                                        // погасить всё
  FastLED.show();

  Serial.println("Готово! Поднеси руку к датчику.");
}


// -------------------------------------------------------------
//  ГЛАВНЫЙ ЦИКЛ (повторяется снова и снова)
// -------------------------------------------------------------
void loop()
{
  // 1) узнаём расстояние
  float raw = readDistanceCM();

  // 2) сглаживаем расстояние, чтобы не дёргалось
  distance = smooth(distance, raw, SMOOTHING);

  // 3) переводим расстояние в количество диодов:
  //    далеко (MAX_DIST) -> 0 диодов, близко (MIN_DIST) -> все диоды
  float target = NUM_LEDS * (MAX_DIST - distance) / (MAX_DIST - MIN_DIST);
  target = constrain(target, 0, NUM_LEDS);

  // 4) сглаживаем и количество, чтобы диоды не мигали на границе
  litCount = smooth(litCount, target, SMOOTHING_LIT);

  // 5) рисуем
  updateLeds(litCount);

  // 6) печатаем в монитор порта для проверки
  Serial.print("расстояние: ");
  Serial.print(distance, 1);
  Serial.print(" см  |  горит диодов: ");
  Serial.println((int)(litCount + 0.5));

  delay(60); // пауза между циклами (миллисекунды)
}
