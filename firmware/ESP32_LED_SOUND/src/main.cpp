// =============================================================
//  ЛЕНТА WS2812B + ЦИФРОВОЙ ЗВУКОВОЙ ДАТЧИК (3 пина)
// =============================================================
//  У нашего датчика НЕТ аналогового выхода — он только выдаёт
//  "есть громкий звук / нет". Поэтому делаем так:
//   - считаем, СКОЛЬКО РАЗ датчик сработал за короткое окно (WINDOW_MS);
//   - чем чаще срабатывает (громче/ритмичнее музыка) -> тем БОЛЬШЕ диодов;
//   - и тем КРАСНЕЕ они (тихо = зелёные, громко = красные);
//   - когда звук стихает -> лента плавно гаснет.
//
//  Все настройки — в config.h.
// =============================================================
//
//  МИНИ-СЛОВАРИК:
//   • digitalRead(pin) – читает 0 (LOW) или 1 (HIGH) с пина.
//   • "фронт"          – момент, когда сигнал меняется LOW->HIGH.
//   • millis()          – сколько миллисекунд прошло с включения.
//   • debounce          – защита от "дребезга" (ложных повторов сигнала).
//   • map()/constrain() – см. прошлый проект (расстояние->диоды).
//
// =============================================================

#include <Arduino.h>
#include <FastLED.h>
#include "config.h"

CRGB leds[NUM_LEDS];

// "Состояние" программы (меняется во время работы):
float litCount = 0.0;        // сколько диодов горит (сглаженное)
float target = 0.0;          // к чему стремимся в текущем окне
int beatCount = 0;           // счётчик срабатываний в текущем окне
bool prevState = LOW;        // прошлое состояние пина (для фронта)
unsigned long lastBeat = 0;  // время последнего срабатывания (антидребезг)
unsigned long windowStart = 0; // начало текущего окна


// -------------------------------------------------------------
//  ПЛАВНОЕ СМЕШИВАНИЕ старого и нового значения
// -------------------------------------------------------------
float smooth(float oldValue, float newValue, float k)
{
  return oldValue + k * (newValue - oldValue);
}


// -------------------------------------------------------------
//  РИСУЕМ на ленте: зажигаем howMany диодов с градиентом
//  зелёный (120) -> красный (0)
// -------------------------------------------------------------
void updateLeds(float howMany)
{
  int count = (int)(howMany + 0.5);
  count = constrain(count, 0, NUM_LEDS);

  for (int i = 0; i < NUM_LEDS; i++)
  {
    if (i < count)
    {
      uint8_t hue = map(i, 0, NUM_LEDS - 1, 120, 0);
      leds[i] = CHSV(hue, 255, 255);
    }
    else
    {
      leds[i] = CRGB::Black;
    }
  }
  FastLED.show();
}


// -------------------------------------------------------------
//  НАСТРОЙКА (один раз при включении)
// -------------------------------------------------------------
void setup()
{
  Serial.begin(115200);
  pinMode(SOUND_PIN, INPUT); // датчик — источник сигнала

  FastLED.addLeds<WS2812B, LED_PIN, GRB>(leds, NUM_LEDS);
  FastLED.setBrightness(LED_BRIGHTNESS);
  FastLED.clear();
  FastLED.show();

  Serial.println("Готово! Включи музыку или похлопай.");
}


// -------------------------------------------------------------
//  ГЛАВНЫЙ ЦИКЛ
// -------------------------------------------------------------
void loop()
{
  unsigned long now = millis();

  // --- ШАГ 1. Ловим КАЖДОЕ срабатывание датчика (фронт LOW->HIGH) ---
  bool state = digitalRead(SOUND_PIN);
  if (state == HIGH && prevState == LOW)
  {
    // антидребезг: игнорируем слишком частые ложные срабатывания
    if (now - lastBeat > DEBOUNCE_MS)
    {
      beatCount++;
      lastBeat = now;
    }
  }
  prevState = state;

  // --- ШАГ 2. Раз в WINDOW_MS пересчитываем "уровень громкости" ---
  if (now - windowStart >= WINDOW_MS)
  {
    // переводим число битов в количество диодов
    target = NUM_LEDS * (float)beatCount / MAX_BEATS;
    target = constrain(target, 0, NUM_LEDS);

    beatCount = 0;          // обнуляем счётчик для следующего окна
    windowStart = now;      // и начинаем новое окно
  }

  // --- ШАГ 3. Плавно движемся к цели (чтобы не дёргалось) ---
  // Если звук стих -> target=0 -> лента мягко гаснет.
  litCount = smooth(litCount, target, SMOOTH);

  // --- ШАГ 4. Рисуем ---
  updateLeds(litCount);

  // --- ШАГ 5. Отладка в монитор порта ---
  Serial.print("битов: ");
  Serial.print(beatCount);
  Serial.print(" | горит диодов: ");
  Serial.println((int)(litCount + 0.5));

  delay(10); // небольшая пауза, чтобы не "спамить" процессор
}
